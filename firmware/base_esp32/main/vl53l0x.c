// VL53L0X, ported from pololu/vl53l0x-arduino (MIT). Only what a downward cliff sensor needs: default 33 ms budget,
// back-to-back continuous mode, non-blocking reads.
#include "vl53l0x.h"

#include "esp_timer.h"
#include "freertos/FreeRTOS.h"
#include "freertos/task.h"

#define TMO_MS 20

static bool wr(vl53l0x_t* s, uint8_t reg, uint8_t v) {
  uint8_t b[2] = {reg, v};
  return i2c_master_transmit(s->dev, b, 2, TMO_MS) == ESP_OK;
}
static uint8_t rd(vl53l0x_t* s, uint8_t reg) {
  uint8_t v = 0;
  i2c_master_transmit_receive(s->dev, &reg, 1, &v, 1, TMO_MS);
  return v;
}
static bool rd_n(vl53l0x_t* s, uint8_t reg, uint8_t* out, size_t n) {
  return i2c_master_transmit_receive(s->dev, &reg, 1, out, n, TMO_MS) == ESP_OK;
}
static bool wait_nz(vl53l0x_t* s, uint8_t reg, uint8_t mask, bool want_nonzero) {
  int64_t end = esp_timer_get_time() + 500000;
  while (((rd(s, reg) & mask) != 0) != want_nonzero) {
    if (esp_timer_get_time() > end) return false;
    vTaskDelay(1);
  }
  return true;
}

static const uint8_t kTuning[][2] = {
    {0xFF, 0x01}, {0x00, 0x00}, {0xFF, 0x00}, {0x09, 0x00}, {0x10, 0x00}, {0x11, 0x00}, {0x24, 0x01}, {0x25, 0xFF},
    {0x75, 0x00}, {0xFF, 0x01}, {0x4E, 0x2C}, {0x48, 0x00}, {0x30, 0x20}, {0xFF, 0x00}, {0x30, 0x09}, {0x54, 0x00},
    {0x31, 0x04}, {0x32, 0x03}, {0x40, 0x83}, {0x46, 0x25}, {0x60, 0x00}, {0x27, 0x00}, {0x50, 0x06}, {0x51, 0x00},
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    {0xFF, 0x00}, {0x80, 0x01}, {0x01, 0xF8}, {0xFF, 0x01}, {0x8E, 0x01}, {0x00, 0x01}, {0xFF, 0x00}, {0x80, 0x00},
};

static bool spad_info(vl53l0x_t* s, uint8_t* count, bool* aperture) {
  wr(s, 0x80, 0x01); wr(s, 0xFF, 0x01); wr(s, 0x00, 0x00);
  wr(s, 0xFF, 0x06); wr(s, 0x83, rd(s, 0x83) | 0x04);
  wr(s, 0xFF, 0x07); wr(s, 0x81, 0x01);
  wr(s, 0x80, 0x01);
  wr(s, 0x94, 0x6B); wr(s, 0x83, 0x00);
  if (!wait_nz(s, 0x83, 0xFF, true)) return false;
  wr(s, 0x83, 0x01);
  uint8_t tmp = rd(s, 0x92);
  *count = tmp & 0x7F;
  *aperture = (tmp >> 7) & 1;
  wr(s, 0x81, 0x00); wr(s, 0xFF, 0x06);
  wr(s, 0x83, rd(s, 0x83) & ~0x04);
  wr(s, 0xFF, 0x01); wr(s, 0x00, 0x01);
  wr(s, 0xFF, 0x00); wr(s, 0x80, 0x00);
  return true;
}

static bool ref_calibration(vl53l0x_t* s, uint8_t vhv_init_byte) {
  wr(s, 0x00, 0x01 | vhv_init_byte);  // SYSRANGE_START
  if (!wait_nz(s, 0x13, 0x07, true)) return false;
  wr(s, 0x0B, 0x01);                  // SYSTEM_INTERRUPT_CLEAR
  wr(s, 0x00, 0x00);
  return true;
}

bool vl53l0x_init(vl53l0x_t* s, i2c_master_bus_handle_t bus, uint8_t new_addr) {
  s->ok = false;
  i2c_device_config_t dc = {.dev_addr_length = I2C_ADDR_BIT_LEN_7, .device_address = 0x29, .scl_speed_hz = 400000};
  if (i2c_master_bus_add_device(bus, &dc, &s->dev) != ESP_OK) return false;
  if (rd(s, 0xC0) != 0xEE) goto fail;  // IDENTIFICATION_MODEL_ID
  wr(s, 0x8A, new_addr & 0x7F);        // I2C_SLAVE_DEVICE_ADDRESS
  i2c_master_bus_rm_device(s->dev);
  dc.device_address = new_addr;
  if (i2c_master_bus_add_device(bus, &dc, &s->dev) != ESP_OK) return false;

  wr(s, 0x89, rd(s, 0x89) | 0x01);  // 2V8 I/O mode
  wr(s, 0x88, 0x00);
  wr(s, 0x80, 0x01); wr(s, 0xFF, 0x01); wr(s, 0x00, 0x00);
  s->stop_variable = rd(s, 0x91);
  wr(s, 0x00, 0x01); wr(s, 0xFF, 0x00); wr(s, 0x80, 0x00);
  wr(s, 0x60, rd(s, 0x60) | 0x12);  // disable MSRC / pre-range signal-rate limit checks
  wr(s, 0x44, 0x00); wr(s, 0x45, 0x20);  // final-range min count rate 0.25 MCPS (Q9.7)
  wr(s, 0x01, 0xFF);

  uint8_t spad_count;
  bool aperture;
  uint8_t map[6];
  if (!spad_info(s, &spad_count, &aperture) || !rd_n(s, 0xB0, map, 6)) goto fail;
  wr(s, 0xFF, 0x01); wr(s, 0x4F, 0x00); wr(s, 0x4E, 0x2C); wr(s, 0xFF, 0x00); wr(s, 0xB6, 0xB4);
  uint8_t first = aperture ? 12 : 0, enabled = 0;
  for (uint8_t i = 0; i < 48; ++i) {
    if (i < first || enabled == spad_count) map[i / 8] &= ~(1 << (i % 8));
    else if ((map[i / 8] >> (i % 8)) & 1) ++enabled;
  }
  uint8_t wbuf[7] = {0xB0};
  for (int i = 0; i < 6; ++i) wbuf[1 + i] = map[i];
  if (i2c_master_transmit(s->dev, wbuf, 7, TMO_MS) != ESP_OK) goto fail;

  for (size_t i = 0; i < sizeof(kTuning) / sizeof(kTuning[0]); ++i) wr(s, kTuning[i][0], kTuning[i][1]);

  wr(s, 0x0A, 0x04);                     // interrupt on new sample ready
  wr(s, 0x84, rd(s, 0x84) & ~0x10);      // active low
  wr(s, 0x0B, 0x01);
  wr(s, 0x01, 0xE8);
  wr(s, 0x01, 0x01);
  if (!ref_calibration(s, 0x40)) goto fail;
  wr(s, 0x01, 0x02);
  if (!ref_calibration(s, 0x00)) goto fail;
  wr(s, 0x01, 0xE8);

  wr(s, 0x80, 0x01); wr(s, 0xFF, 0x01); wr(s, 0x00, 0x00);
  wr(s, 0x91, s->stop_variable);
  wr(s, 0x00, 0x01); wr(s, 0xFF, 0x00); wr(s, 0x80, 0x00);
  wr(s, 0x00, 0x02);  // back-to-back continuous
  s->ok = true;
  return true;
fail:
  i2c_master_bus_rm_device(s->dev);
  return false;
}

int vl53l0x_poll(vl53l0x_t* s) {
  if (!s->ok || (rd(s, 0x13) & 0x07) == 0) return -1;
  uint8_t b[2];
  if (!rd_n(s, 0x14 + 10, b, 2)) return -1;
  wr(s, 0x0B, 0x01);
  return (b[0] << 8) | b[1];
}
